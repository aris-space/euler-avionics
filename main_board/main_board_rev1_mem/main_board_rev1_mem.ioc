# file: main_board_rev1_mem.ioc
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FREERTOS.Tasks01=defaultTask,24,128,StartDefaultTask,Default,NULL,Dynamic,NULL,NULL;task_sb_read,24,2048,vTaskSbRead,Default,NULL,Static,task_sb_readBuffer,task_sb_readControlBlock;task_gps_read,24,2048,vTaskGpsRead,Default,NULL,Static,task_gps_readBuffer,task_gps_readControlBlock;task_sen_fusion,24,2048,vTaskSensorFusion,Default,NULL,Static,task_sen_fusionBuffer,task_sen_fusionControlBlock;task_fsm,24,2048,vTaskFsm,Default,NULL,Static,task_fsmBuffer,task_fsmControlBlock
Mcu.Family=STM32F7
Mcu.Name=STM32F745V(E-G)Tx
Mcu.Package=LQFP100
NVIC.PriorityGroup=NVIC_PRIORITYGROUP_4
NVIC.TIM1_UP_TIM10_IRQn=true\:0\:0\:false\:false\:true\:false\:false\:true
NVIC.TimeBase=TIM1_UP_TIM10_IRQn
NVIC.TimeBaseIP=TIM1
ProjectManager.HeapSize=0x200
ProjectManager.StackSize=0x400
ProjectManager.TargetToolchain=STM32CubeIDE
RCC.HSE_VALUE=25000000
RCC.HSI_VALUE=16000000
RCC.LSE_VALUE=32768
RCC.USBFreq_Value=96000000
RCC.VCOOutputFreq_Value=192000000
VP_FREERTOS_VS_CMSIS_V2.Mode=CMSIS_V2
VP_SYS_VS_tim1.Mode=TIM1
board=custom

// file: Core/Src/main.c
/* USER CODE BEGIN Header */
/**
  ******************************************************************************
  * @file           : main.c
  * @brief          : Main program body
  ******************************************************************************
  * @attention
  *
  * <h2><center>&copy; Copyright (c) 2020 STMicroelectronics.
  * All rights reserved.</center></h2>
  *
  * This software component is licensed by ST under BSD 3-Clause license,
  * the "License"; You may not use this file except in compliance with the
  * License. You may obtain a copy of the License at:
  *                        opensource.org/licenses/BSD-3-Clause
  *
  ******************************************************************************
  */
/* USER CODE END Header */

#include "main.h"
#include "cmsis_os.h"

/* USER CODE BEGIN Includes */
#include "typedef.h"
/* USER CODE END Includes */

typedef StaticTask_t osStaticThreadDef_t;
osThreadId_t defaultTaskHandle;
osThreadId_t task_sb_readHandle;
uint32_t task_sb_readBuffer[ 2048 ];
osStaticThreadDef_t task_sb_readControlBlock;
osThreadId_t task_gps_readHandle;
uint32_t task_gps_readBuffer[ 2048 ];
osStaticThreadDef_t task_gps_readControlBlock;
osThreadId_t task_sen_fusionHandle;
uint32_t task_sen_fusionBuffer[ 2048 ];
osStaticThreadDef_t task_sen_fusionControlBlock;
osThreadId_t task_fsmHandle;
uint32_t task_fsmBuffer[ 2048 ];
osStaticThreadDef_t task_fsmControlBlock;
/* USER CODE BEGIN PV */
osMutexId_t sb_mutex;
sb_data sb1, sb2, sb3;

osMutexId_t gps_mutex;
gps_data gps1, gps2;
/* USER CODE END PV */

void SystemClock_Config(void);
void StartDefaultTask(void *argument);
void vTaskSbRead(void *argument);
void vTaskGpsRead(void *argument);
void vTaskSensorFusion(void *argument);
void vTaskFsm(void *argument);

int main(void)
{

  /* MCU Configuration--------------------------------------------------------*/

  /* Reset of all peripherals, Initializes the Flash interface and the Systick. */
  HAL_Init();

  /* Configure the system clock */
  SystemClock_Config();

  /* Initialize all configured peripherals */

  osKernelInitialize();

  /* USER CODE BEGIN RTOS_MUTEX */
  /* Sensor Board Mutex */
  const osMutexAttr_t sb_mutex_attr = {
    "sb_mutex",                          // human readable mutex name
    osMutexPrioInherit,    // attr_bits
    NULL,                                     // memory for control block
    0U                                        // size for control block
  };

  sb_mutex = osMutexNew(&sb_mutex_attr);

  const osMutexAttr_t gps_mutex_attr = {
    "gps_mutex",                          // human readable mutex name
    osMutexPrioInherit,    // attr_bits
    NULL,                                     // memory for control block
    0U                                        // size for control block
  };

  gps_mutex = osMutexNew(&gps_mutex_attr);
  /* USER CODE END RTOS_MUTEX */

  /* Create the thread(s) */
  /* definition and creation of defaultTask */
  const osThreadAttr_t defaultTask_attributes = {
    .name = "defaultTask",
    .priority = (osPriority_t) osPriorityNormal,
    .stack_size = 128
  };
  defaultTaskHandle = osThreadNew(StartDefaultTask, NULL, &defaultTask_attributes);

  /* definition and creation of task_sb_read */
  const osThreadAttr_t task_sb_read_attributes = {
    .name = "task_sb_read",
    .stack_mem = &task_sb_readBuffer[0],
    .stack_size = sizeof(task_sb_readBuffer),
    .cb_mem = &task_sb_readControlBlock,
    .cb_size = sizeof(task_sb_readControlBlock),
    .priority = (osPriority_t) osPriorityNormal,
  };
  task_sb_readHandle = osThreadNew(vTaskSbRead, NULL, &task_sb_read_attributes);

  /* definition and creation of task_gps_read */
  const osThreadAttr_t task_gps_read_attributes = {
    .name = "task_gps_read",
    .stack_mem = &task_gps_readBuffer[0],
    .stack_size = sizeof(task_gps_readBuffer),
    .cb_mem = &task_gps_readControlBlock,
    .cb_size = sizeof(task_gps_readControlBlock),
    .priority = (osPriority_t) osPriorityNormal,
  };
  task_gps_readHandle = osThreadNew(vTaskGpsRead, NULL, &task_gps_read_attributes);

  /* definition and creation of task_sen_fusion */
  const osThreadAttr_t task_sen_fusion_attributes = {
    .name = "task_sen_fusion",
    .stack_mem = &task_sen_fusionBuffer[0],
    .stack_size = sizeof(task_sen_fusionBuffer),
    .cb_mem = &task_sen_fusionControlBlock,
    .cb_size = sizeof(task_sen_fusionControlBlock),
    .priority = (osPriority_t) osPriorityNormal,
  };
  task_sen_fusionHandle = osThreadNew(vTaskSensorFusion, NULL, &task_sen_fusion_attributes);

  /* definition and creation of task_fsm */
  const osThreadAttr_t task_fsm_attributes = {
    .name = "task_fsm",
    .stack_mem = &task_fsmBuffer[0],
    .stack_size = sizeof(task_fsmBuffer),
    .cb_mem = &task_fsmControlBlock,
    .cb_size = sizeof(task_fsmControlBlock),
    .priority = (osPriority_t) osPriorityNormal,
  };
  task_fsmHandle = osThreadNew(vTaskFsm, NULL, &task_fsm_attributes);

  /* Start scheduler */
  osKernelStart();

  /* We should never get here as control is now taken by the scheduler */

  /* Infinite loop */
  while (1)
  {

  }
}

void SystemClock_Config(void)
{
  RCC_OscInitTypeDef RCC_OscInitStruct = {0};
  RCC_ClkInitTypeDef RCC_ClkInitStruct = {0};

  /** Configure the main internal regulator output voltage
  */
  __HAL_RCC_PWR_CLK_ENABLE();
  __HAL_PWR_VOLTAGESCALING_CONFIG(PWR_REGULATOR_VOLTAGE_SCALE3);
  /** Initializes the CPU, AHB and APB busses clocks
  */
  RCC_OscInitStruct.OscillatorType = RCC_OSCILLATORTYPE_HSI;
  RCC_OscInitStruct.HSIState = RCC_HSI_ON;
  RCC_OscInitStruct.HSICalibrationValue = RCC_HSICALIBRATION_DEFAULT;
  RCC_OscInitStruct.PLL.PLLState = RCC_PLL_NONE;
  if (HAL_RCC_OscConfig(&RCC_OscInitStruct) != HAL_OK)
  {
    Error_Handler();
  }
  /** Initializes the CPU, AHB and APB busses clocks
  */
  RCC_ClkInitStruct.ClockType = RCC_CLOCKTYPE_HCLK|RCC_CLOCKTYPE_SYSCLK
                              |RCC_CLOCKTYPE_PCLK1|RCC_CLOCKTYPE_PCLK2;
  RCC_ClkInitStruct.SYSCLKSource = RCC_SYSCLKSOURCE_HSI;
  RCC_ClkInitStruct.AHBCLKDivider = RCC_SYSCLK_DIV1;
  RCC_ClkInitStruct.APB1CLKDivider = RCC_HCLK_DIV1;
  RCC_ClkInitStruct.APB2CLKDivider = RCC_HCLK_DIV1;

  if (HAL_RCC_ClockConfig(&RCC_ClkInitStruct, FLASH_LATENCY_0) != HAL_OK)
  {
    Error_Handler();
  }
}

void StartDefaultTask(void *argument)
{
  for(;;)
  {
    osDelay(1);
  }
}

void HAL_TIM_PeriodElapsedCallback(TIM_HandleTypeDef *htim)
{
  if (htim->Instance == TIM1) {
    HAL_IncTick();
  }
}

void Error_Handler(void)
{
}

/************************ (C) COPYRIGHT STMicroelectronics *****END OF FILE****/
